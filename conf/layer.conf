## conf/layer.conf
```bitbake
# We have a conf and classes directory, append to BBPATH
BBPATH .= ":${LAYERDIR}"

# We have a recipes directory, add to BBFILES
BBFILES += "${LAYERDIR}/recipes*/*/*.bb ${LAYERDIR}/recipes*/*/*.bbappend"

BBFILE_COLLECTIONS += "meta-micropython"
BBFILE_PATTERN_meta-micropython := "^${LAYERDIR}/"
BBFILE_PRIORITY_meta-micropython = "7"

LAYERDEPENDS_meta-micropython = "core"

LAYERSERIES_COMPAT_meta-micropython = "honister hardknott gatesgarth dunfell"
```
